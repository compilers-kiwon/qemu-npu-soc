## br2-external/Config.in
```kconfig
# SPDX-FileCopyrightText: 2026 Kiwon Kwon
# SPDX-License-Identifier: GPL-2.0-or-later

source "$BR2_EXTERNAL_KN1_PATH/package/qemu-kn1/Config.in.host"
source "$BR2_EXTERNAL_KN1_PATH/package/knpu/Config.in"
source "$BR2_EXTERNAL_KN1_PATH/package/knpu-tests/Config.in"
source "$BR2_EXTERNAL_KN1_PATH/package/knpu-runtime/Config.in"
source "$BR2_EXTERNAL_KN1_PATH/package/knpu-models/Config.in"
```

## br2-external/configs/kn1_evb_defconfig
```kconfig
BR2_aarch64=y
BR2_cortex_a72=y
BR2_PACKAGE_HOST_LINUX_HEADERS_CUSTOM_7_1=y
BR2_GLOBAL_PATCH_DIR="$(BR2_EXTERNAL_KN1_PATH)/patches"
BR2_DOWNLOAD_FORCE_CHECK_HASHES=y
BR2_ROOTFS_OVERLAY="$(BR2_EXTERNAL_KN1_PATH)/board/kn1-evb/rootfs-overlay"
BR2_ROOTFS_POST_IMAGE_SCRIPT="$(BR2_EXTERNAL_KN1_PATH)/board/kn1-evb/post-image.sh"
BR2_LINUX_KERNEL=y
BR2_LINUX_KERNEL_CUSTOM_VERSION=y
BR2_LINUX_KERNEL_CUSTOM_VERSION_VALUE="7.3.1"
BR2_LINUX_KERNEL_USE_ARCH_DEFAULT_CONFIG=y
BR2_LINUX_KERNEL_DTS_SUPPORT=y
BR2_LINUX_KERNEL_CUSTOM_DTS_DIR="$(BR2_EXTERNAL_KN1_PATH)/../linux/dts"
BR2_LINUX_KERNEL_INSTALL_TARGET=y
BR2_LINUX_KERNEL_NEEDS_HOST_OPENSSL=y
BR2_TARGET_ROOTFS_EXT2=y
BR2_TARGET_ROOTFS_EXT2_4=y
BR2_TARGET_ROOTFS_EXT2_SIZE="256M"
# BR2_TARGET_ROOTFS_TAR is not set
BR2_TARGET_ARM_TRUSTED_FIRMWARE=y
BR2_TARGET_ARM_TRUSTED_FIRMWARE_CUSTOM_VERSION=y
BR2_TARGET_ARM_TRUSTED_FIRMWARE_CUSTOM_VERSION_VALUE="v2.15.0"
BR2_TARGET_ARM_TRUSTED_FIRMWARE_PLATFORM="kn1"
BR2_TARGET_ARM_TRUSTED_FIRMWARE_FIP=y
BR2_TARGET_ARM_TRUSTED_FIRMWARE_UBOOT_AS_BL33=y
BR2_TARGET_ARM_TRUSTED_FIRMWARE_ADDITIONAL_VARIABLES="OPENSSL_DIR=$(HOST_DIR) HOSTLD=gcc HOSTLDFLAGS=-Wl,-rpath,$(HOST_DIR)/lib"
BR2_TARGET_ARM_TRUSTED_FIRMWARE_IMAGES="bl1.bin fip.bin"
BR2_TARGET_UBOOT=y
BR2_TARGET_UBOOT_BUILD_SYSTEM_KCONFIG=y
BR2_TARGET_UBOOT_CUSTOM_GIT=y
BR2_TARGET_UBOOT_CUSTOM_REPO_URL="https://source.denx.de/u-boot/u-boot.git"
BR2_TARGET_UBOOT_CUSTOM_REPO_VERSION="v2026.10"
BR2_TARGET_UBOOT_BOARD_DEFCONFIG="kn1-evb"
BR2_TARGET_UBOOT_NEEDS_OPENSSL=y
BR2_TARGET_UBOOT_NEEDS_GNUTLS=y
BR2_TARGET_UBOOT_CUSTOM_DTS_PATH="$(BR2_EXTERNAL_KN1_PATH)/../linux/dts/kiwon/kn1-evb.dts $(BR2_EXTERNAL_KN1_PATH)/../linux/dts/kiwon/kn1.dtsi"
BR2_PACKAGE_HOST_GENIMAGE=y
BR2_PACKAGE_HOST_QEMU_KN1=y
```

## br2-external/package/knpu-models/Config.in
```kconfig
# SPDX-FileCopyrightText: 2026 Kiwon Kwon
# SPDX-License-Identifier: GPL-2.0-or-later

config BR2_PACKAGE_KNPU_MODELS
	bool "knpu-models"
	help
	  The test models of the kn1-npu compiled to model.knpu, with
	  their inputs and expected outputs, from models/ of this
	  repository: the convolution test model in
	  /usr/share/knpu/conv/, the MNIST CNN with the MNIST digit
	  images in /usr/share/knpu/mnist/, and the ResNet-8 with its
	  photographs in /usr/share/knpu/resnet8/. V6 runs them with
	  knpu-infer.
```

## br2-external/package/knpu-runtime/Config.in
```kconfig
# SPDX-FileCopyrightText: 2026 Kiwon Kwon
# SPDX-License-Identifier: GPL-2.0-or-later

config BR2_PACKAGE_KNPU_RUNTIME
	bool "knpu-runtime"
	depends on BR2_PACKAGE_HOST_RUSTC_TARGET_ARCH_SUPPORTS
	select BR2_PACKAGE_HOST_RUSTC
	help
	  libknpu and knpu-infer, the user-space runtime of the
	  kn1-npu (/usr/bin/knpu-infer), from runtime/ of this
	  repository. knpu-infer runs a model.knpu file through the
	  knpu driver.
```

## br2-external/package/knpu-tests/Config.in
```kconfig
# SPDX-FileCopyrightText: 2026 Kiwon Kwon
# SPDX-License-Identifier: GPL-2.0-or-later

config BR2_PACKAGE_KNPU_TESTS
	bool "knpu-tests"
	depends on BR2_LINUX_KERNEL
	select BR2_PACKAGE_KNPU
	help
	  V5, the knpu driver test that runs in the kn1-evb guest
	  (/usr/bin/knpu-test), from tests/driver/ of this
	  repository.

comment "knpu-tests needs a Linux kernel to be built"
	depends on !BR2_LINUX_KERNEL
```

## br2-external/package/knpu/Config.in
```kconfig
# SPDX-FileCopyrightText: 2026 Kiwon Kwon
# SPDX-License-Identifier: GPL-2.0-or-later

config BR2_PACKAGE_KNPU
	bool "knpu"
	depends on BR2_LINUX_KERNEL
	help
	  DRM accel driver for the kn1-npu (/dev/accel/accel0), built
	  as an out-of-tree kernel module from linux/knpu/ of this
	  repository. Turns on CONFIG_DRM_ACCEL in the kernel and
	  installs the UAPI header drm/knpu_accel.h to staging.

comment "knpu needs a Linux kernel to be built"
	depends on !BR2_LINUX_KERNEL
```

## br2-external/package/qemu-kn1/Config.in.host
```kconfig
# SPDX-FileCopyrightText: 2026 Kiwon Kwon
# SPDX-License-Identifier: GPL-2.0-or-later

config BR2_PACKAGE_HOST_QEMU_KN1
	bool "host qemu-kn1"
	depends on BR2_HOST_GCC_AT_LEAST_8
	help
	  QEMU 11.1.3 for the build host, with the kiwon-kn1 SoC and
	  the kn1-evb machine added from hw/qemu/ of this repository.
	  Only the aarch64 system emulator is built.

	  https://www.qemu.org

comment "host qemu-kn1 needs a host gcc >= 8"
	depends on !BR2_HOST_GCC_AT_LEAST_8
```

## firmware/u-boot/board/kiwon/kn1-evb/Kconfig
```kconfig
# SPDX-License-Identifier: GPL-2.0-or-later
# SPDX-FileCopyrightText: 2026 Kiwon Kwon

if TARGET_KN1_EVB

config SYS_BOARD
	default "kn1-evb"

config SYS_VENDOR
	default "kiwon"

endif
```

## firmware/u-boot/configs/kn1-evb_defconfig
```kconfig
CONFIG_ARM=y
CONFIG_TARGET_KN1_EVB=y
CONFIG_TEXT_BASE=0x60000000
CONFIG_HAS_CUSTOM_SYS_INIT_SP_ADDR=y
CONFIG_CUSTOM_SYS_INIT_SP_ADDR=0x60000000
CONFIG_DEFAULT_DEVICE_TREE="kn1-evb"
CONFIG_SYS_LOAD_ADDR=0x40400000
CONFIG_BOOTSTD_DEFAULTS=y
# CONFIG_DISPLAY_CPUINFO is not set
# CONFIG_BOARD_INIT is not set
CONFIG_CMD_POWEROFF=y
# CONFIG_NET is not set
CONFIG_CLK=y
# CONFIG_MMC is not set
CONFIG_SYSRESET=y
CONFIG_SYSRESET_CMD_POWEROFF=y
CONFIG_SYSRESET_PSCI=y
CONFIG_VIRTIO_MMIO=y
CONFIG_VIRTIO_BLK=y
```
